## boards/shields/granja/Kconfig.defconfig
```kconfig
if SHIELD_GRANJA_LEFT

# Name must be less than 16 characters long!
config ZMK_KEYBOARD_NAME
    default "Granja"

config ZMK_SPLIT_ROLE_CENTRAL
    default y

endif

if SHIELD_GRANJA_LEFT || SHIELD_GRANJA_RIGHT

config ZMK_SPLIT
    default y

endif
```

## boards/shields/granja/Kconfig.shield
```kconfig
config SHIELD_GRANJA_LEFT
    def_bool $(shields_list_contains,granja_left)

config SHIELD_GRANJA_RIGHT
    def_bool $(shields_list_contains,granja_right)
```
